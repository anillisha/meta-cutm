## conf/bblayers.conf
```bitbake
# POKY_BBLAYERS_CONF_VERSION is increased each time build/conf/bblayers.conf
# changes incompatibly
POKY_BBLAYERS_CONF_VERSION = "2"

BBPATH = "${TOPDIR}"
BBFILES ?= ""

BBLAYERS ?= " \
  /home/alisha/Desktop/ypd/poky/meta \
  /home/alisha/Desktop/ypd/poky/meta-poky \
  /home/alisha/Desktop/ypd/poky/meta-yocto-bsp \
  /home/alisha/Desktop/ypd/meta-raspberrypi \
  /home/alisha/Desktop/ypd/meta-openembedded/meta-oe \
  /home/alisha/Desktop/ypd/meta-openembedded/meta-python \
  /home/alisha/Desktop/ypd/meta-openembedded/meta-networking \
  /home/alisha/Desktop/ypd/meta-openembedded/meta-multimedia \
  /home/alisha/Desktop/ypd/meta-openembedded/meta-filesystems \
  /home/alisha/Desktop/ypd/meta-qt5 \
  /home/alisha/Desktop/ypd/meta-cutm \
  "
```

## meta-cutm/conf/layer.conf
```bitbake
# We have a conf and classes directory, add to BBPATH
BBPATH .= ":${LAYERDIR}"

# We have recipes-* directories, add to BBFILES
BBFILES += "${LAYERDIR}/recipes-*/*/*.bb \
            ${LAYERDIR}/recipes-*/*/*.bbappend"

BBFILE_COLLECTIONS += "meta-cutm"
BBFILE_PATTERN_meta-cutm = "^${LAYERDIR}/"
BBFILE_PRIORITY_meta-cutm = "6"

LAYERDEPENDS_meta-cutm = "core"
LAYERSERIES_COMPAT_meta-cutm = "dunfell"
```
